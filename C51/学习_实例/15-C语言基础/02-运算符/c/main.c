/*------------------------------------------------
  功能：C51运算符演示
  硬件：P0口接LED
  说明：展示常用运算符的用法
------------------------------------------------*/
#include <reg51.h>

void main(void)
{
    unsigned char a, b, c;

    /*--- 算术运算符 ---*/
    a = 10 + 3;     // a = 13（加）
    a = 10 - 3;     // a = 7（减）
    a = 10 * 3;     // a = 30（乘）
    a = 10 / 3;     // a = 3（整除，不是3.33）
    a = 10 % 3;     // a = 1（取余）

    /*--- 赋值运算符 ---*/
    a = 10;
    a += 5;          // a = a + 5 = 15
    a -= 3;          // a = a - 3 = 12
    a *= 2;          // a = a * 2 = 24
    a /= 4;          // a = a / 4 = 6

    /*--- 关系运算符 ---*/
    if (a > 5) P0_0 = 0;    // 大于
    if (a < 10) P0_1 = 0;   // 小于
    if (a >= 6) P0_2 = 0;   // 大于等于
    if (a <= 6) P0_3 = 0;   // 小于等于
    if (a == 6) P0_4 = 0;   // 等于
    if (a != 5) P0_5 = 0;   // 不等于

    /*--- 逻辑运算符 ---*/
    if (a > 5 && a < 10) P0_6 = 0;  // 与
    if (a > 10 || a < 5) P0_7 = 0;  // 或
    if (!(a > 10)) P0_0 = 0;        // 非

    /*--- 位运算符 ---*/
    a = 0xFF;
    a = a & 0x0F;    // 0x0F（取低4位）
    a = a | 0xF0;    // 0xFF（置高4位）
    a = a ^ 0xFF;    // 0x00（取反）
    a = ~a;           // 0xFF（按位取反）
    a = a << 2;       // 左移2位
    a = a >> 2;       // 右移2位

    while (1);
}
