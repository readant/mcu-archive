/*********************************************
 * 阶段2：独立按键检测
 * 功能：按键按下时LED亮，松开后LED灭
 * 
 * 硬件连接：
 *   1. 按键：一端接P3.2引脚，另一端接GND（低电平有效）
 *      → P3.2 额外添加 10kΩ 外部上拉电阻到VCC，提升电平稳定性（因为8051的P3口内部已有弱上拉，外部上拉非必须，但加上更可靠）
 *      - 按键未按下：P3.2 为高电平（5V）
 *      - 按键按下：P3.2 被拉低（0V）
 *   2. LED：正极接VCC，负极通过470Ω电阻接P1.0（低电平点亮）
 *   3. 晶振：12MHz
 * 
 * 教学重点：
 *   1. 独立按键的硬件连接与电平检测
 *   2. 按键消抖的必要性（硬件抖动现象）
 *   3. 延时消抖与等待释放的实现
 *   4. 中断引脚P3.2（INT0）的普通IO使用
 *********************************************/

#include <reg51.h>      // 头文件：定义了所有特殊功能寄存器（如P1、P0等），让我们可以直接写P1^0，P3^2

// 引脚定义
// sbit：Keil C51的特殊关键字，用来声明一个单独的引脚
// P1^0 中的 ^ 不是“异或”，而是“点”的意思，表示P1口的第0位
sbit LED = P1^0;        // LED控制引脚（低电平点亮）
sbit KEY = P3^2;        // 独立按键引脚（低电平表示按下）

/* ------------------------------------------------------------------
 * 函数名：delay_ms
 * 功能：  毫秒级延时（12MHz晶振，Keil默认优化）
 * 参数：  ms - 延时毫秒数
 * 原理：  空循环消耗时间，内层循环120次约1ms
 * 注意：  不同晶振需调整内层循环次数
 * ------------------------------------------------------------------ */
void delay_ms(unsigned int ms)
{
    unsigned int i, j;
	//外层循环：执行m次
    for(i = ms; i > 0; i--)
		// 内层循环：大约120次 ≈ 1ms        
        for(j = 120; j > 0; j--);  
}

/* ------------------------------------------------------------------
 * 主函数：无限循环检测按键状态，控制LED亮灭
 * 流程：
 *   1. 初始化LED熄灭
 *   2. 循环检测KEY引脚是否为低电平（按键按下）
 *   3. 检测到按下后，消抖延时10ms，再次确认
 *   4. 确认按下：点亮LED，然后等待按键释放
 *   5. 按键释放后，延时10ms消抖，熄灭LED
 * ------------------------------------------------------------------ */
void main(void)
{
    LED = 1;    // 初始化：LED熄灭（高电平熄灭，低电平点亮）
	//// 虽然复位后P1口默认高电平，但显式赋值是好习惯
    // 注意：按键引脚不需要初始化，因为8051复位后默认就是高电平输入状态
    while(1)    // 无限循环，不断检测按键
    {
        // ----- 检测按键是否被按下（低电平有效）-----
        if(KEY == 0)                 // 第一次检测到低电平
        {
            delay_ms(10);            // 延时10ms跳过抖动期
            if(KEY == 0)             // 再次检测，确认仍是低电平（消抖成功）
            {
                LED = 0;             // 点亮LED
                
                // 等待按键释放：当KEY变为高电平时退出循环
                while(KEY == 0);     // 空循环，直到按键松开
                
                delay_ms(10);        // 释放后延时消抖（防止释放时抖动）
                LED = 1;             // 熄灭LED
            }
        }
    }
}

/* ==================== 常见问题教学解释（新手必读） ====================
 * Q1: 为什么要加消抖延时？不加会怎样？
 * A1: 机械按键在按下和释放瞬间会产生几毫秒的抖动（电平快速高低变化），
 *     如果不加消抖，单片机可能检测到多次按下/释放，导致LED闪烁或逻辑混乱。
 *     消抖方法：检测到电平变化后，延时10~20ms，再读一次电平确认状态。
 *
 * Q2: 为什么按键接GND而不是VCC？
 * A2: 8051的I/O口内部有弱上拉，按键接GND时，未按下是高电平，按下是低电平，
 *     这种接法简单，无需外部上拉电阻。（但是我建议可以接上上拉电阻，就像我
 *	   的工程图）如果按键接VCC，则需外部下拉电阻，且按键按下时输入高电平，编
 *	   程时需相应调整（检测KEY==1）。
 *
 * Q3: while(KEY==0); 的作用是什么？不写会怎样？
 * A3: 这个循环称为“等待释放”。如果省略它，单片机会极快循环检测，
 *     由于LED已点亮，但主循环会继续检测到KEY==0，导致LED反复亮灭或闪烁。
 *     等待释放确保一次按键按下只产生一次亮/灭动作。
 *
 * Q4: 释放后的 delay_ms(10) 有必要吗？
 * A4: 有必要。按键释放时同样存在抖动，加10ms延时可确保稳定释放后再熄灭LED，
 *     避免因释放抖动导致LED意外熄灭后又亮起。这是工程上的良好习惯。
 *
 * Q5: 为什么LED初始化为1（熄灭）？
 * A5: 为了防止上电后LED误亮。虽然8051复位后P1口默认为1，但显式写LED=1
 *     可以明确告诉阅读者：一开始LED是灭的，这是良好的编程习惯。
 *
 * Q6: P3.2是外部中断0引脚，可以作为普通IO使用吗？
 * A6: 完全可以。P3口的每个引脚都有第二功能，但不启用对应中断或第二功能时，
 *     它们就是普通IO口，可以像P1一样进行读写操作。
 *
 * Q7: 延时10ms是怎么来的？
 * A7: 机械按键的抖动时间通常为5~10ms，延时10ms足以覆盖抖动窗口，
 *     同时不会让人感觉到明显延迟。如果延时太短（如1ms），可能无法消除抖动；
 *     太长（如100ms）则会感到按键响应迟钝。
 * ================================================================ */