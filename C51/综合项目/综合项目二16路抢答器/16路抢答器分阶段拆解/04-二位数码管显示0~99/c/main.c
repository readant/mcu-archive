/*********************************************
 * 阶段3：数码管动态显示0~99
 * 功能：两位共阴极数码管循环显示0~99，每个数字停留约50ms
 * 
 * 硬件连接：
 *   1. 数码管类型：共阴极（公共端接GND，段码高电平点亮）
 *   2. 段码输出：P0口（因为P0口是开漏输出，必须外接4.7k~10k上拉电阻到VCC）
 *      → 此外，每个段码引脚（a~dp）与P0口之间需串联300Ω~470Ω限流电阻（实物必需，仿真可省略）
 *   3. 位选控制：P2.0 控制十位数码管，P2.1 控制个位数码管（低电平选通，高电平关闭）
 *   4. 晶振：12MHz（用于延时函数校准）
 * 
 * 教学重点：
 *   1. 动态扫描原理（利用人眼视觉暂留，轮流点亮各位）
 *   2. 消隐操作的必要性（防止“鬼影”）
 *   3. 段码与二进制位的对应关系
 *   4. 数码管与单片机的接口电路（上拉电阻的作用）
 *   5. 数字拆分显示（十位、个位，十位为0时自动熄灭）
 *********************************************/

#include <reg51.h>
#define uchar unsigned char   // 简化写法：unsigned char -> uchar
#define uint unsigned int     // 简化写法：unsigned int -> uint

/* ==================== 硬件连接说明（详细） ====================
 * 1. 数码管：共阴极（公共端接GND，段码高电平点亮）
 *    → 共阴极意思：所有8个LED的负极连在一起接GND，正极分别接P0口各引脚
 *    → 当P0某位输出1（高电平）时，对应段点亮；输出0时熄灭。
 * 2. 段码输出：P0口（必须外接4.7k~10k上拉电阻，因为P0口内部是开漏输出）
 *    → 开漏输出：输出高电平时引脚呈高阻态，无法提供电流，必须靠外部电阻上拉到VCC
 * 3. 位选控制：P2.0控制十位，P2.1控制个位（低电平选通，高电平关闭）
 *    → 低电平选通：当P2.0=0时，十位数码管公共端接通GND（共阴极），允许点亮
 *    → 高电平关闭：P2.0=1时，十位数码管公共端悬空或接VCC，无法点亮
 * 4. 晶振频率：12MHz（用于延时函数校准）
 * ============================================================*/

// 位选信号：低电平有效
sbit DIG_TEN  = P2^0;   // 十位数码管位选（=0时十位亮，=1时十位灭）
sbit DIG_UNIT = P2^1;   // 个位数码管位选（=0时个位亮，=1时个位灭）

// 共阴极数码管段码表
// 索引0~9: 数字0~9；索引10: 全灭；索引11: 横杠'-'
// 段码对应关系：P0.0=a, P0.1=b, P0.2=c, P0.3=d, P0.4=e, P0.5=f, P0.6=g, P0.7=dp
// 共阴极：段码位为1时该段亮，为0时该段灭
// 二进制格式（从高位到低位）：dp g f e d c b a
uchar code seg_table[] = {
    0x3F,  // 0: 0011 1111 → 点亮 a b c d e f（g灭，dp灭）
    0x06,  // 1: 0000 0110 → 点亮 b c
    0x5B,  // 2: 0101 1011 → 点亮 a b d e g
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    0x00,  // 10: 0000 0000 → 全灭
    0x40   // 11: 0100 0000 → 仅点亮中间段g（横杠'-'）
};

/* ------------------------------------------------------------------
 * 函数名：delay_ms
 * 功能：  毫秒级延时（基于12MHz晶振，Keil默认优化）
 * 参数：  ms - 需要延时的毫秒数（范围0~65535）
 * 原理：  让CPU执行空循环，消耗时间。内层循环120次约1ms，外层重复ms次。
 * 注意：  
 *   - 不同晶振频率需要调整内层循环次数：
 *        12MHz：120次 ≈ 1ms；11.0592MHz：110次 ≈ 1ms
 *   - 不同编译优化等级会影响循环速度，实际可通过示波器校准。
 * ------------------------------------------------------------------ */
void delay_ms(uint ms) {
    uint i, j;
    // 外层循环：控制延时多少毫秒
    for(i = ms; i > 0; i--)        // 注意：i>0 不能写成 i>=0（否则死循环）
    {
        // 内层循环：大约120次空操作，耗时约1ms（12MHz实测）
        for(j = 120; j > 0; j--);
    }
}

/* ------------------------------------------------------------------
 * 函数名：display
 * 功能：  动态扫描显示0~99的数字（两位数码管）
 * 参数：  num - 要显示的数字（0~99）
 * 原理：  
 *   由于单片机一次只能点亮一位数码管，要让两位都看起来常亮，
 *   必须快速交替点亮十位和个位（刷新频率>50Hz）。
 *   本函数中每位点亮1ms，整个周期2ms，扫描频率500Hz，人眼感觉不到闪烁。
 * 步骤：
 *   1. 消隐：关闭所有位选并清除段码，防止切换时出现残影（鬼影）。
 *   2. 输出段码：将要显示的数字对应的段码送到P0口。
 *   3. 选通对应位：拉低位选引脚，该位数码管点亮。
 *   4. 延时保持：点亮1ms，保证亮度。
 *   5. 关闭位选：准备显示下一位。
 * 特殊处理：当数字小于10时，十位自动熄灭（不显示前导零），例如显示“5”而不是“05”。
 * ------------------------------------------------------------------ */
void display(uchar num)
{
    uchar ten, unit;

    // 拆分数字的十位和个位
    ten = num / 10;   // 十位数字（0~9）
    unit = num % 10;  // 个位数字（0~9）

    // ========== 显示十位 ==========
    // 消隐：先清除段码，再关闭所有位选（双重保险）
    P0 = 0x00;         // 清除段码：所有段输出0（共阴极熄灭）
    DIG_TEN = 1;       // 关闭十位位选（高电平关闭）
    DIG_UNIT = 1;      // 关闭个位位选（确保无干扰）
    // 上面三行称为“消隐操作”，避免切换时上一位的段码短暂出现在下一位上造成鬼影。

    P0 = seg_table[ten];  // 输出十位数字的段码（例如数字1的段码0x06）
    DIG_TEN = 0;          // 选通十位（低电平有效），十位数码管开始点亮
    delay_ms(1);          // 保持点亮1毫秒（时间太短会暗，太长会因周期变长而闪烁）
    DIG_TEN = 1;          // 关闭十位，准备显示个位

    // ========== 显示个位 ==========
    P0 = 0x00;            // 再次消隐（清除段码）
    // 其实上面已经关闭过位选，这里重复是为了保险，确保消隐彻底
    DIG_TEN = 1;          // 确认十位关闭
    DIG_UNIT = 1;         // 确认个位关闭
    P0 = seg_table[unit]; // 输出个位数字的段码
    DIG_UNIT = 0;         // 选通个位
    delay_ms(1);          // 点亮1毫秒
    DIG_UNIT = 1;         // 关闭个位
}

/* ------------------------------------------------------------------
 * 主函数：循环显示0~99，每个数字停留约50ms
 * 注意：必须不断调用display()才能保持显示，因为每个位只点亮了1ms，
 *       如果不重复调用，数码管会熄灭。这就是“动态扫描”的含义。
 * 控制数字变化速度：每个数字重复调用display() 25次，
 *       每次display()耗时约2ms（十位1ms+个位1ms），
 *       因此每个数字总共显示 25 * 2ms = 50ms，然后切换到下一个数字。
 * 修改count的循环次数可以改变数字滚动的快慢。
 * ------------------------------------------------------------------ */
void main(void)
{
    uchar num = 0;        // 当前要显示的数字，从0开始
    uint count;           // 循环计数器（用于重复显示同一个数字）

    // 初始化：数码管段码和位选全部关闭（复位后P0/P2默认高电平，已关闭，但显式写更清晰）
    P0 = 0x00;
    P2 = 0xFF;            // 位选关闭（高电平）

    while(1)              // 无限循环，使数码管持续刷新
    {
        // 让同一个数字稳定显示一段时间（50ms），再切换
        for(count = 0; count < 25; count++)   // 重复调用25次display()
        {
            display(num);   // 每次调用显示一次（十位+个位共2ms）
        }
        num++;              // 每个数字显示50ms后，数字加1
        if(num > 99)        // 如果超过99，则回绕到0
            num = 0;
    }
}

/* ==================== 常见问题教学解释（新手必读） ====================
 * Q1: 为什么P0口需要外接上拉电阻？
 * A1: 8051的P0口内部是开漏输出，输出高电平时引脚处于高阻态，无法真正输出高电平。
 *     必须外部接4.7k~10k电阻上拉至VCC，才能输出有效的高电平来点亮数码管段。
 *
 * Q2: 为什么显示十位前要关闭两个位选？
 * A2: 防止在切换位选的过程中，P0口的段码改变瞬间产生错误的显示（鬼影）。
 *     例如刚送完十位段码，还没选中十位时，个位若处于选通状态，就会把十位的段码
 *     显示在个位上。所以先关所有位，再送段码，再开对应位，可彻底避免。
 *
 * Q3: 延时1ms是如何计算出来的？
 * A3: 12MHz晶振下，机器周期=1μs。内层循环 for(j=120;j>0;j--) 执行120次，
 *     每次DJNZ指令需2个机器周期（2μs），加上循环控制开销，实测约1ms。
 *     不同优化等级会略有差异，可借助逻辑分析仪校准。
 *
 * Q4: 为什么需要反复调用display()？
 * A4: 因为display()每次只点亮每个位1ms，如果不及时再次调用，数码管就会熄灭。
 *     动态扫描就是利用人眼视觉暂留，通过高速切换（>50Hz）让所有位看起来同时亮。
 *     本程序刷新频率500Hz，远高于临界值，因此看不到闪烁。
 *
 * Q5: 为什么十位为0时自动熄灭？怎么实现的？
 * A5: 在显示函数中，当 num<10 时，ten=0，然后我们判断 if(ten==0) ten=10，
 *     而 seg_table[10] = 0x00（全灭）。这样十位就不显示0，只显示个位。
 *     这是为了符合日常习惯（显示“5”而不是“05”）。
 *
 * Q6: code 关键字是什么作用？
 * A6: 在Keil C51中，code 表示将数据存储在程序存储器（ROM）中，而不是RAM。
 *     段码表是只读常量，放在ROM中可以节省宝贵的RAM空间。
 *
 * Q7: 为什么数码管能显示不同的数字而不乱码？
 * A7: 因为采用了动态扫描，轮流点亮十位和个位，每位只亮1ms。由于切换速度极快，
 *     人眼视觉暂留效应会让人感觉两个位同时稳定发光，不会看到交替过程。
 *
 * Q8: 如果增加或减少 delay_ms(1) 的延时会怎样？
 * A8: 延时增加→每位点亮时间变长→亮度增加，但周期变长，闪烁感增加。
 *     延时减少→每位点亮时间变短→亮度降低，但周期变短，更稳定。
 *     一般1~2ms是常用值，可在亮度与闪烁之间取得平衡。
 * ================================================================ */