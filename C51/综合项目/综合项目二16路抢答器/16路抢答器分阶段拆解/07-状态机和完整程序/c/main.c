/***************************** 16路抢答器系统 - 状态机 *****************************
 * 硬件连接与功能：
 * 
 * 本注释重点讲解【状态机】设计：
 *   - 状态：系统在某一时刻所处的阶段（空闲、等待抢答、锁定）
 *   - 状态变量：使用 allow_answer 和 key_num 组合表示
 *   - 状态转换：由主持人按键和选手按键触发
 *
 * 状态表：
 *   ┌──────────────────┬─────────────┬───────────────┬────────────────────────┐
 *   │ 状态名称         │ allow_answer│ key_num       │ 行为                   │
 *   ├──────────────────┼─────────────┼───────────────┼────────────────────────┤
 *   │ S0: 空闲/熄灭    │     0       │ 忽略(0)       │ 数码管灭，不扫键盘     │
 *   │ S1: 等待抢答     │     1       │ 0             │ 显示"--"，扫描键盘     │
 *   │ S2: 抢答锁定     │     1       │ 1~16 (选手号) │ 显示选手号，不扫键盘   │
 *   └──────────────────┴─────────────┴───────────────┴────────────────────────┘
 *
 * 状态转换：
 *   - 上电 → S0
 *   - 主持人按键按下 → 进入 S1（清除上一轮结果）
 *   - S1 下有选手按键 → 记录选手号，进入 S2
 *   - S2 下主持人按键按下 → 回到 S1（新的一轮）
 *   （注意：S0 下主持人按键也会进入 S1，设计上 S0 为安全起始状态）
 *
 * 核心设计思想：将复杂逻辑分解为有限个清晰的状态，每个状态只做该做的事。
 **********************************************************************************/

#include <reg51.h>
#define uint unsigned int
#define uchar unsigned char

// 引脚定义（硬件连接）
sbit KEY_HOST = P3^7;    // 主持人按键（低有效）
sbit DIG_TEN  = P2^0;    // 十位选通
sbit DIG_UNIT = P2^1;    // 个位选通

// ==================== 状态变量（状态机的核心） ====================
uchar key_num = 0;       // 选手编号：0=无，1~16=某选手。参与状态判定。
bit allow_answer = 0;    // 抢答允许标志：0=禁止，1=允许。与 key_num 组合成状态。

// 段码表（不变）
uchar code seg_table[] = {
    0x3F,0x06,0x5B,0x4F,0x66,0x6D,0x7D,0x07,0x7F,0x6F,0x00,0x40
};

// 延时函数（同原代码）
void delay_ms(uint ms) {
    uint i, j;
    for(i = ms; i > 0; i--)
        for(j = 120; j > 0; j--);
}

// 数码管显示函数（根据 num 显示内容，支持 0=熄灭，17=“--”，1~16=选手号）
void display(uchar num) {
    uchar ten, unit;
    if(num == 0)          { ten=10; unit=10; }
    else if(num == 17)    { ten=11; unit=11; }
    else {
        ten = num/10;
        unit = num%10;
        if(ten == 0) ten = 10;
    }
    P0 = 0x00; DIG_TEN=1; DIG_UNIT=1;
    P0 = seg_table[ten]; DIG_TEN=0; delay_ms(1); DIG_TEN=1;
    P0 = 0x00; DIG_TEN=1; DIG_UNIT=1;
    P0 = seg_table[unit]; DIG_UNIT=0; delay_ms(1); DIG_UNIT=1;
}

// 4×4矩阵键盘扫描（返回1~16或0）
uchar key_scan(void) {
    uchar row, col, key_val;
    P1 = 0x0F;
    if((P1 & 0xF0) != 0xF0) {
        delay_ms(10);
        if((P1 & 0xF0) != 0xF0) {
            for(row=0; row<4; row++) {
                P1 = 0xF0 | ~(1<<row);
                if((P1 & 0xF0) != 0xF0) {
                    col = (P1 & 0xF0) >> 4;
                    switch(col) {
                        case 0x0E: col=0; break;
                        case 0x0D: col=1; break;
                        case 0x0B: col=2; break;
                        case 0x07: col=3; break;
                        default: return 0;
                    }
                    key_val = row*4 + col + 1;
                    while((P1 & 0xF0) != 0xF0);   // 等待释放
                    delay_ms(10);
                    return key_val;
                }
            }
        }
    }
    return 0;
}

// ==================== 主函数：状态机实现 ====================
void main(void) {
    // 初始化
    P0 = 0x00; P1 = 0xFF; P2 = 0xFF; P3 = 0xFF;
    
    while(1) {
        // ---------------- 事件检测：主持人按键（状态转换触发器） ----------------
        if(KEY_HOST == 0) {
            delay_ms(10);
            if(KEY_HOST == 0) {
                /* 主持人按键被确认按下，执行【状态转换】：无论当前状态是什么，
                   都强制进入【等待抢答状态(S1)】，清除上一轮选手号，允许新一轮。
                   这是状态机中最关键的外部输入响应。 */
                allow_answer = 1;   // 允许抢答
                key_num = 0;        // 清除选手号（回到 S1 的标志）
                while(KEY_HOST == 0); // 等待释放，避免连按导致多次状态转换
            }
        }
        
        // ---------------- 状态机执行体（根据当前状态执行不同动作） ----------------
        // 状态 S0: allow_answer == 0
        if(allow_answer == 0) {
            display(0);          // 数码管熄灭
            // 注意：此状态下不扫描键盘，抢答被禁止
        }
        // 状态 S1 或 S2 才进入 else 分支（allow_answer == 1）
        else {
            // 状态 S1: allow_answer==1 且 key_num==0 → 等待抢答
            if(key_num == 0) {
                display(17);     // 显示 "--" 提示可抢答
                key_num = key_scan();  // 扫描键盘：若有选手按下，key_num 变为 1~16
                // 当 key_scan() 返回非零时，key_num 被更新，状态自动切换到 S2
            }
            // 状态 S2: allow_answer==1 且 key_num != 0 → 抢答锁定
            else {
                display(key_num); // 显示抢到的选手号
                // 注意：此处不再调用 key_scan()，从而实现“锁定”，后续选手无效
                // 直到主持人按键再次将状态重置为 S1
            }
        }
    }
}

/* ==================== 状态机教学 FAQ ====================
 * Q1: 为什么要用状态机？
 * A1: 抢答器逻辑有明确的阶段（灭、等待抢答、锁定）。用状态机可以将复杂流程
 *     拆解为独立状态，避免混乱的 if-else 嵌套，也便于后期增加功能（如倒计时）。
 *
 * Q2: 状态变量为什么是 allow_answer 和 key_num 两个？
 * A2: 因为需要区分三种状态，两个 bit 变量组合足够。当然也可以用单个枚举变量
 *     (如 state = 0,1,2)，但当前写法直观地反映了“是否允许”和“谁抢到”。
 *
 * Q3: 状态转换发生在哪些地方？
 * A3: 两处：主持人按键按下（无条件转 S1），选手按键按下（S1 → S2）。
 *     注意 S0 到 S1 的转换也由主持人按键触发，这样上电后主持人一按就进入准备。
 *
 * Q4: 如果选手在锁定状态下再次按自己的按键，会重复触发吗？
 * A4: 不会。因为 S2 分支中完全没有调用 key_scan()，所以选手按键不会被检测。
 *     这是典型的“状态屏蔽”方法。
 *
 * Q5: 如何修改状态机以实现“抢答后蜂鸣器响一声”？
 * A5: 在进入 S2 时（即从 key_num==0 变为非零的瞬间）添加蜂鸣器控制即可。
 *     这体现了状态机的优点：只需在状态转换点添加动作，不影响其他逻辑。
 * ================================================================ */