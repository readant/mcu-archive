/*********************************************
 * 阶段5：数码管显示横杠“--”
 * 功能：两位共阴极数码管稳定显示“--”（两个横杠）
 * 
 * 硬件连接：
 *   1. 数码管类型：共阴极（公共端接GND，段码高电平点亮）
 *   2. 段码输出：P0口（必须外接4.7k~10k上拉电阻，因P0口为开漏输出）
 *      - 开漏输出：输出高电平时引脚呈高阻态，无法提供电流，必须靠外部电阻上拉到VCC
 *      → 此外，每个段码引脚（a~dp）与P0口之间需串联300Ω~470Ω限流电阻（实物必需，仿真可省略）
 *   3. 位选控制：P2.0 控制十位数码管，P2.1 控制个位数码管（低电平选通，高电平关闭）
 *   4. 晶振：12MHz（用于延时函数校准）
 * 
 * 教学重点：
 *   1. 动态扫描原理（轮流点亮各位，利用人眼视觉暂留）
 *   2. 消隐操作的必要性（防止“鬼影”）
 *   3. 段码与二进制位的对应关系
 *   4. 延时时间对亮度与闪烁的影响
 *   5. 单片机I/O口初始化的重要性
 *********************************************/

#include <reg51.h>
#define uchar unsigned char   // 简化写法：unsigned char -> uchar
#define uint unsigned int     // 简化写法：unsigned int -> uint

/* ==================== 硬件连接说明（详细） ====================
 * 1. 数码管：共阴极（公共端接GND，段码高电平点亮）
 *    → 共阴极意思：所有8个LED的负极连在一起接GND，正极分别接P0口各引脚
 *    → 当P0某位输出1（高电平）时，对应段点亮；输出0时熄灭。
 * 2. 段码输出：P0口（必须外接4.7k~10k上拉电阻，因为P0口内部是开漏输出）
 *    → 开漏输出：输出高电平时引脚呈高阻态，无法提供电流，必须靠外部电阻上拉到VCC
 * 3. 位选控制：P2.0控制十位，P2.1控制个位（低电平选通，高电平关闭）
 *    → 低电平选通：当P2.0=0时，十位数码管公共端接通GND（共阴极），允许点亮
 *    → 高电平关闭：P2.0=1时，十位数码管公共端悬空或接VCC，无法点亮
 * 4. 晶振频率：12MHz（用于延时函数校准）
 * ============================================================*/

// 位选信号：低电平有效
sbit DIG_TEN  = P2^0;   // 十位数码管位选（=0时十位亮，=1时十位灭）
sbit DIG_UNIT = P2^1;   // 个位数码管位选（=0时个位亮，=1时个位灭）

/* ----------------------- 共阴极数码管段码表 ----------------------- 
 * 段码对应：P0.0=a, P0.1=b, P0.2=c, P0.3=d, P0.4=e, P0.5=f, P0.6=g, P0.7=dp
 * 共阴极：段码位=1 → 该段亮；段码位=0 → 该段灭
 * 索引0~9：数字0~9；索引10：全灭；索引11：横杠'-'（仅中间段g点亮）
 * 二进制格式（从高位到低位）：dp g f e d c b a
 */
uchar code seg_table[] = {
    0x3F,  // 0: 0011 1111 → a b c d e f 亮
    0x06,  // 1: 0000 0110 → b c 亮
    0x5B,  // 2: 0101 1011 → a b d e g 亮
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    0x00,  // 10: 0000 0000 → 所有段熄灭
    0x40   // 11: 0100 0000 → 仅中间段g点亮（横杠'-'）
};

/* ------------------------------------------------------------------
 * 函数名：delay_ms
 * 功能：  毫秒级延时（基于12MHz晶振，Keil默认优化）
 * 参数：  ms - 需要延时的毫秒数（范围0~65535）
 * 原理：  让CPU执行空循环，消耗时间。内层循环120次约1ms，外层重复ms次。
 * 注意：  
 *   - 不同晶振频率需要调整内层循环次数：
 *        12MHz：120次 ≈ 1ms；11.0592MHz：110次 ≈ 1ms
 *   - 不同编译优化等级会影响循环速度，实际可通过示波器校准。
 * ------------------------------------------------------------------ */
void delay_ms(uint ms) {
    uint i, j;
    // 外层循环：控制延时多少毫秒
    for(i = ms; i > 0; i--)        // 注意：i>0 不能写成 i>=0（否则死循环）
    {
        // 内层循环：大约120次空操作，耗时约1ms（12MHz实测）
        for(j = 120; j > 0; j--);
    }
}

/* ------------------------------------------------------------------
 * 函数名：display_dash
 * 功能：  动态扫描显示两位横杠“--”
 * 原理：  
 *   由于单片机一次只能点亮一位数码管，要让两位都看起来常亮，
 *   必须快速交替点亮十位和个位（刷新频率>50Hz）。
 *   本函数中每位点亮2ms，整个周期4ms，扫描频率250Hz，人眼感觉不到闪烁。
 * 步骤：
 *   1. 消隐：关闭所有位选并清除段码，防止切换时出现残影（鬼影）。
 *   2. 输出段码：将要显示的数字（横杠）对应的段码送到P0口。
 *   3. 选通对应位：拉低位选引脚，该位数码管点亮。
 *   4. 延时保持：点亮2ms，保证亮度。
 *   5. 关闭位选：准备显示下一位。
 * 注意：  消隐操作必须完整，否则会在切换瞬间产生“残影”。
 * ------------------------------------------------------------------ */
void display_dash(void) {
    /* ---------- 显示十位横杠 ---------- */
    // 消隐：先清除段码，再关闭所有位选（双重保险）
    P0 = 0x00;          // 清除段码：所有段输出0（共阴极熄灭）
    DIG_TEN = 1;        // 关闭十位位选（高电平关闭）
    DIG_UNIT = 1;       // 关闭个位位选（确保无干扰）
    // 以上三行称为“消隐操作”，避免切换时上一位的段码短暂出现在下一位上造成鬼影。

    P0 = seg_table[11]; // 输出横杠段码（0x40，仅中间段g点亮）
    DIG_TEN = 0;        // 选通十位（低电平有效），十位数码管开始显示横杠
    delay_ms(2);        // 保持点亮2毫秒（时间太短会暗，太长会因周期变长而闪烁）
    DIG_TEN = 1;        // 关闭十位，准备显示个位

    /* ---------- 显示个位横杠 ---------- */
    P0 = 0x00;          // 再次消隐（清除段码）
    DIG_TEN = 1;        // 确保十位已关闭
    DIG_UNIT = 1;       // 关闭个位
    P0 = seg_table[11]; // 输出横杠段码
    DIG_UNIT = 0;       // 选通个位
    delay_ms(2);        // 点亮2毫秒
    DIG_UNIT = 1;       // 关闭个位
}

/* ------------------------------------------------------------------
 * 主函数：无限循环调用显示函数，维持动态扫描
 * 说明：  
 *   如果不反复调用display_dash()，数码管会因只点亮一次而熄灭。
 *   必须持续扫描，才能利用人眼视觉暂留形成稳定显示。
 *   初始化I/O口可以避免上电瞬间数码管出现乱码。
 * ------------------------------------------------------------------ */
void main(void) {
    // 初始化I/O口：清除段码，关闭所有位选（避免上电时意外显示）
    P0 = 0x00;   // 数码管段码初始为0（熄灭）
    P2 = 0xFF;   // 位选关闭（高电平熄灭）

    while(1)             // 无限循环，使数码管持续刷新
    {
        display_dash();   // 反复刷新，使两位横杠看起来常亮
    }
}

/* ==================== 常见问题教学解释（新手必读） ====================
 * Q1: 为什么P0口需要外接上拉电阻？
 * A1: 8051的P0口内部是开漏输出，输出高电平时引脚处于高阻态，无法真正输出高电平。
 *     必须外部接4.7k~10k电阻上拉至VCC，才能输出有效的高电平来点亮数码管段。
 *
 * Q2: 为什么显示前要消隐（清段码+关位选）？
 * A2: 防止动态扫描切换时产生“鬼影”。如果不消隐，旧段码可能短暂出现在新选通的
 *     数码管上，造成残影。先消隐再送新段码可彻底避免。
 *
 * Q3: 延时2ms是如何选择的？
 * A3: 每位点亮2ms，整个周期4ms（250Hz），人眼不会感到闪烁。
 *     如果延时太长（如10ms），周期20Hz，人眼会看到明显闪烁；
 *     如果太短（如0.5ms），亮度会降低。2ms是亮度与稳定性的折中。
 *
 * Q4: 为什么需要反复调用display_dash()？
 * A4: 因为display_dash()只点亮每个位2ms，如果不及时再次调用，数码管就会熄灭。
 *     动态扫描就是利用人眼视觉暂留，通过高速切换让所有位看起来同时亮。
 *
 * Q5: 为什么主函数中要初始化P0和P2？
 * A5: 虽然8051复位后P0和P2默认是高电平（P0开漏实际为高阻，但通常也视为高），
 *     但显式初始化可以确保上电瞬间数码管不会出现乱码，代码也更加清晰健壮。
 *
 * Q6: code 关键字是什么作用？
 * A6: 在Keil C51中，code 表示将数据存储在程序存储器（ROM）中，而不是RAM。
 *     段码表是只读常量，放在ROM中可以节省宝贵的RAM空间。
 *
 * Q7: 为什么延时函数中内层循环用120？
 * A7: 根据12MHz晶振实测调整：机器周期1μs，DJNZ指令2μs，循环120次约240μs，
 *     加上外层循环控制开销，实测约1ms。这是经验值，不同晶振需调整。
 * ================================================================ */