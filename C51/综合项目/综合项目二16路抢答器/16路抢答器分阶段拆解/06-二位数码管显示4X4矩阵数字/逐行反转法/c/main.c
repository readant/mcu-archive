/*********************************************
 * 阶段6：矩阵键盘显示按键号（1~16）
 * 功能：按下4×4矩阵键盘任意键，数码管显示对应编号（1~16），松开后保持最后数字
 * 
 * 硬件连接：
 *   1. 4×4矩阵键盘：
 *      - 行线：P1.0 ~ P1.3（输出，用于逐行扫描）
 *      - 列线：P1.4 ~ P1.7（输入，带内部上拉电阻）
 *      → 注意：P1口内部已有弱上拉，通常不需外接电阻；若线路较长或抗干扰要求高，可外接10k上拉。
 *   2. 两位共阴极数码管：
 *      - 段码输出：P0口（必须外接4.7k~10k上拉电阻，因为P0口是开漏输出）
 *        → 此外，每个段码引脚（a~dp）与P0口之间需串联300Ω~470Ω限流电阻（实物必需，仿真可省略）
 *      - 位选控制：P2.0 控制十位，P2.1 控制个位（低电平选通，高电平关闭）
 *   3. 晶振：12MHz（用于延时函数校准）
 * 
 * 教学重点：
 *   1. 4×4矩阵键盘的逐行扫描原理（如何确定哪个按键被按下）
 *   2. 动态扫描数码管显示（利用视觉暂留，轮流点亮十位和个位）
 *   3. 按键消抖（硬件抖动消除）与等待释放（防止一次按下多次触发）
 *   4. 数字的拆分显示（十位、个位，且十位为0时熄灭，不显示前导零）
 *   5. 延时函数的计算与调整（12MHz晶振下循环120次≈1ms）
 *   6. C89标准下变量声明必须在函数开头
 *********************************************/

#include <reg51.h>       
#define uchar unsigned char   // 简化写法：unsigned char -> uchar
#define uint unsigned int     // 简化写法：unsigned int -> uint

/* ==================== 硬件接口定义 ==================== */
// 数码管位选信号（低电平有效）
sbit DIG_TEN  = P2^0;   // 十位数码管位选（=0时点亮，=1时熄灭）
sbit DIG_UNIT = P2^1;   // 个位数码管位选（=0时点亮，=1时熄灭）

/* ==================== 共阴极数码管段码表 ==================== 
 * 段码对应：P0.0=a, P0.1=b, P0.2=c, P0.3=d, P0.4=e, P0.5=f, P0.6=g, P0.7=dp
 * 共阴极：段码位=1 → 该段亮；段码位=0 → 该段灭
 * 索引0~9：数字0~9；索引10：全灭；索引11：横杠'-'（本程序中未使用）
 * 二进制格式（从高位到低位）：dp g f e d c b a
 */
uchar code seg_table[] = {
    0x3F,  // 0: 0011 1111 → a b c d e f 亮
    0x06,  // 1: 0000 0110 → b c 亮
    0x5B,  // 2: 0101 1011 → a b d e g 亮
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    0x00,  // 10: 0000 0000 → 全灭
    0x40   // 11: 0100 0000 → 仅中间段g点亮（横杠'-'）
};

/* ------------------------------------------------------------------
 * 函数名：delay_ms
 * 功能：  毫秒级延时（基于12MHz晶振，Keil默认优化）
 * 参数：  ms - 需要延时的毫秒数（范围0~65535）
 * 原理：  两重循环，内层循环120次空操作约1ms，外层重复ms次。
 * 注意：  
 *   - 不同晶振频率需要调整内层循环次数：
 *        12MHz：120次 ≈ 1ms；11.0592MHz：110次 ≈ 1ms
 *   - 不同优化等级会影响精度，建议用逻辑分析仪校准。
 *   - 循环条件 i>0 不能写成 i>=0（无符号数会死循环）。
 * ------------------------------------------------------------------ */
void delay_ms(uint ms) {
    uint i, j;
    for(i = ms; i > 0; i--)        // 外层：延时ms毫秒
        for(j = 120; j > 0; j--);  // 内层：约1ms（Keil默认优化实测值）
}

/* ------------------------------------------------------------------
 * 函数名：display
 * 功能：  动态扫描显示0~16的数字（两位数码管，十位为0时熄灭）
 * 参数：  num - 要显示的数字。0=熄灭，1~16正常显示。
 * 原理：  
 *   由于单片机一次只能点亮一位数码管，要让两位都看起来常亮，
 *   必须快速交替点亮十位和个位（刷新频率>50Hz）。
 *   本函数每位点亮1ms，周期2ms（扫描频率500Hz），人眼感觉不到闪烁。
 * 步骤：
 *   1. 消隐：关闭所有位选并清除段码，防止切换时出现残影（鬼影）。
 *   2. 输出段码：将要显示的数字对应的段码送到P0口。
 *   3. 选通对应位：拉低位选引脚，该位数码管点亮。
 *   4. 延时保持：点亮1ms，保证亮度。
 *   5. 关闭位选：准备显示下一位。
 * 特殊处理：当数字小于10时，十位自动熄灭（不显示前导零）。
 * ------------------------------------------------------------------ */
void display(uchar num) {
    uchar ten, unit;
    
    // 根据num值决定十位和个位显示的段码索引
    if(num == 0) {
        // 熄灭状态：十位和个位都送“全灭”段码（索引10）
        ten = 10;
        unit = 10;
    } else {
        // 正常数字1~16：拆分十位和个位
        ten = num / 10;   // 十位数字（0~1）
        unit = num % 10;  // 个位数字（0~9）
        if(ten == 0) {
            ten = 10;     // 十位为0时，不显示0，改为熄灭
        }
    }
    
    /* ---------- 显示十位 ---------- */
    // 消隐：先清除段码，再关闭所有位选（防止残影）
    P0 = 0x00;           // 清除段码（所有段输出0）
    DIG_TEN = 1;         // 关闭十位位选（高电平关闭）
    DIG_UNIT = 1;        // 关闭个位位选（双重保险）
    
    P0 = seg_table[ten]; // 输出十位数字的段码
    DIG_TEN = 0;         // 选通十位（低电平有效），十位数码管点亮
    delay_ms(1);         // 保持点亮1毫秒（亮度与闪烁的平衡点）
    DIG_TEN = 1;         // 关闭十位，准备显示个位
    
    /* ---------- 显示个位 ---------- */
    P0 = 0x00;           // 再次消隐
    DIG_TEN = 1;
    DIG_UNIT = 1;
    P0 = seg_table[unit];// 输出个位段码
    DIG_UNIT = 0;        // 选通个位
    delay_ms(1);         // 点亮1毫秒
    DIG_UNIT = 1;        // 关闭个位
}

/* ------------------------------------------------------------------
 * 函数名：key_scan
 * 功能：  检测4×4矩阵键盘，返回被按下按键的编号（1~16），无按键返回0
 * 原理：  逐行扫描法（又称“行反转法”）
 * 步骤：
 *   1. 所有行线输出低电平，读取列线，判断是否有键按下。
 *   2. 延时10ms消抖，再次检测确认。
 *   3. 逐行输出低电平，读取列线，确定具体按键的行列位置。
 *   4. 计算按键编号（行号×4+列号+1）。
 *   5. 等待按键释放（防止连按）。
 *   6. 返回编号。
 * 变量含义：
 *   row     : 行号（0~3），表示当前扫描的行，对应P1.0~P1.3
 *   col     : 列号（0~3），表示检测到的按键所在的列，对应P1.4~P1.7
 *   key_val : 按键编号（1~16），根据 row*4+col+1 计算得出
 * ------------------------------------------------------------------ */
uchar key_scan(void) {
    uchar row, col, key_val;
    
    // 第一步：检测是否有按键按下（所有行输出0）
    P1 = 0x0F;   // 低四位输出0，高四位输入（写入1使其成为输入，利用内部上拉）
    if((P1 & 0xF0) != 0xF0)   // 若高四位不全为1，说明有键按下
    {
        delay_ms(10);         // 延时消抖
        if((P1 & 0xF0) != 0xF0)   // 再次确认，消除抖动影响
        {
            // 第二步：逐行扫描，确定具体按键
            for(row = 0; row < 4; row++)
            {
                // 设置当前行输出0，其他行输出1；高四位保持输入（1）
                // ~(1 << row) 产生低四位屏蔽字：0xFE,0xFD,0xFB,0xF7
                P1 = 0xF0 | ~(1 << row);
                if((P1 & 0xF0) != 0xF0)   // 若某列变为0，表示该行有键按下
                {
                    // 读取列线状态（高四位）
                    col = (P1 & 0xF0) >> 4;
                    // 将列值映射为列号 0~3
                    switch(col)
                    {
                        case 0x0E: col = 0; break;  // 1110 → P1.4
                        case 0x0D: col = 1; break;  // 1101 → P1.5
                        case 0x0B: col = 2; break;  // 1011 → P1.6
                        case 0x07: col = 3; break;  // 0111 → P1.7
                        default: return 0;
                    }
                    // 计算按键编号：行号×4 + 列号 + 1（范围1~16）
                    key_val = row * 4 + col + 1;
                    // 等待按键释放（避免连按）
                    while((P1 & 0xF0) != 0xF0);  // 轮询直到所有列线恢复高电平
                    delay_ms(10);                // 释放后短暂延时，消除释放抖动
                    return key_val;
                }
            }
        }
    }
    return 0;   // 无按键按下
}

/* ------------------------------------------------------------------
 * 主函数
 * 功能：  初始化I/O口，无限循环扫描键盘并刷新数码管显示。
 * 流程：  
 *   1. 初始化变量 cur_num = 0（熄灭状态），初始化I/O口。
 *   2. 进入主循环：
 *      - 调用 display(cur_num) 动态刷新数码管
 *      - 调用 key_scan() 获取按键值
 *      - 如果有按键按下，更新 cur_num 为新值
 * 注意：display() 必须反复调用，否则数码管会熄灭（动态扫描特性）。
 * ------------------------------------------------------------------ */
void main(void) {
    uchar cur_num = 0;      // 当前要显示的数字（0表示熄灭）
    uchar key;              // 临时存储键值（变量声明必须在函数开头）
    
    // 初始化I/O口状态
    P0 = 0x00;              // 数码管段码初始为0（熄灭），可以在这里改成两条-
    P1 = 0xFF;              // P1口全部写1，为输入做准备
    P2 = 0xFF;              // 关闭所有位选（高电平关闭）
    // P3口未使用，保持默认
    
    // 主循环：持续扫描和显示
    while(1) {
        display(cur_num);   // 动态刷新数码管（必须频繁调用）
        key = key_scan();   // 扫描矩阵键盘，获取按键编号（1~16或0）
        if(key != 0) {
            cur_num = key;  // 有新按键按下，更新显示的数字
        }
        // 注意：没有额外延时，因为display()内部已有1ms+1ms的延时，
        // 且key_scan()在无按键时很快返回，整体循环周期约2ms，足够保持显示稳定。
    }
}

/* ==================== 常见问题教学解释（新手必读） ====================
 * Q1: 为什么P0口需要外接上拉电阻？
 * A1: 8051的P0口内部是开漏输出，输出高电平时引脚处于高阻态，无法提供电流。
 *     必须外部接4.7k~10k电阻上拉至VCC，才能输出有效高电平点亮数码管段。
 *
 * Q2: 为什么显示十位前要关闭两个位选并清除段码？
 * A2: 防止“鬼影”现象。如果不消隐，在切换位选瞬间，旧的段码可能会短暂出现在新选通的
 *     数码管上，造成残影。先关位选、清段码，再送新段码、开位选，可彻底避免。
 *
 * Q3: 延时1ms是如何计算出来的？
 * A3: 12MHz晶振下，机器周期=1μs。内层循环 for(j=120;j>0;j--) 执行120次，
 *     每次DJNZ指令需2个机器周期（2μs），加上循环控制开销，共约240μs，
 *     外层循环控制ms次，近似得到1ms。实际可用示波器校准。
 *
 * Q4: 为什么必须反复调用display()？
 * A4: 因为display()每次只点亮每个位1ms，如果不及时再次调用，数码管就会熄灭。
 *     动态扫描利用人眼视觉暂留，需要以高于50Hz的频率刷新（本程序500Hz），
 *     才能看起来稳定常亮。
 *
 * Q5: 按键扫描中为什么要等待按键释放？
 * A5: 避免一次按下导致多次触发。如果不等待释放，主循环会极快地反复检测到同一个按键，
 *     导致cur_num被反复赋同样的值，虽然没有错误，但可能会增加不必要的处理负担。
 *     等待释放还能确保每次按键只响应一次。
 *
 * Q6: 为什么变量声明必须在函数开头？
 * A6: Keil C51默认使用C89标准，该标准要求函数内所有局部变量声明必须放在
 *     所有可执行语句之前。如果放在后面，编译器会报语法错误。
 *
 * Q7: 如何计算按键编号？为什么是 row*4+col+1？
 * A7: 因为每行有4个按键，行号row（0~3）决定了这一行的起始编号：row*4。
 *     列号col（0~3）表示该行第几个按键，加上列号再+1（让编号从1开始）即得到1~16。
 *     例如：第2行第3列 → row=1, col=2 → 1*4+2+1=7。
 * ================================================================ */