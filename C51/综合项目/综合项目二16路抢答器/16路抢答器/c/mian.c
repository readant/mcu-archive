/***************************** 16路抢答器系统*****************************
 * 硬件连接说明：
 *   1. 主持人按键：P3.7，低电平有效，外接10k上拉电阻
 *   2. 4×4矩阵键盘：行线 P1.0~P1.3，列线 P1.4~P1.7（实物P1口推荐外接上拉电阻）
 *   3. 两位共阴极数码管：
 *        - 段码输出：P0口（必须外接4.7k~10k上拉电阻，因P0口开漏）
 *         → 此外，每个段码引脚（a~dp）与P0口之间需串联300Ω~470Ω限流电阻（实物必需，仿真可省略）
 *        - 位选：P2.0 控制十位，P2.1 控制个位（低电平选通）
 *   4. 晶振：12MHz（用于延时函数校准）
 * 
 * 功能说明：
 *   - 系统上电后数码管熄灭，禁止抢答。
 *   - 按下主持人按键后，数码管显示“--”，允许选手抢答。
 *   - 任一选手按下按键，数码管立即显示其编号（1~16），并锁定，后续选手无效。
 *   - 再次按下主持人按键，清除上一轮结果，数码管显示“--”，开始新一轮抢答。
 * 
 * 重点：
 *   1. 状态机设计（三种状态：熄灭、允许抢答、锁定）
 *   2. 4×4矩阵键盘逐行扫描、消抖、等待释放
 *   3. 动态扫描数码管显示（消隐防止鬼影）
 *   4. 抢答锁定机制（保证仅最先按下的选手生效）
 *   5. 主持人按键边沿检测与防连按
 ******************************************************************************/

#include <reg51.h>
#define uint unsigned int
#define uchar unsigned char

// ************************ 引脚定义 ************************
sbit KEY_HOST = P3^7;    // 主持人按键（低电平有效，外接10k上拉）
sbit DIG_TEN  = P2^0;    // 十位数码管位选（低电平有效）
sbit DIG_UNIT = P2^1;    // 个位数码管位选（低电平有效）

// ************************ 全局变量与常量定义 ************************
uchar key_num = 0;       // 抢答者编号：0=无，1~16=对应选手
bit allow_answer = 0;    // 抢答允许标志：0=禁止，1=允许

// 共阴极数码管段码表（索引0~9：数字0~9，索引10：全灭，索引11：横杠'-'）
// 段码对应：P0.0=a, P0.1=b, P0.2=c, P0.3=d, P0.4=e, P0.5=f, P0.6=g, P0.7=dp
// 二进制格式（从高位到低位）：dp g f e d c b a
uchar code seg_table[] = {
    0x3F,  // 0: 0011 1111 → 点亮 a b c d e f（g灭，dp灭）
    0x06,  // 1: 0000 0110 → 点亮 b c
    0x5B,  // 2: 0101 1011 → 点亮 a b d e g
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    0x00,  // 10: 0000 0000 → 全灭（所有段熄灭）
    0x40   // 11: 0100 0000 → 仅点亮中间段g（横杠'-'）
};

// ************************ 延时函数（12MHz晶振，约1ms）************************
// 功能：实现ms毫秒的延时，用于消抖、动态扫描等
// 原理：两重循环，内层循环120次约1ms，外层重复ms次
// 注意：不同晶振或编译优化等级需调整内层循环次数（如11.0592MHz改为110）
void delay_ms(uint ms)
{
    uint i, j;
    for(i = ms; i > 0; i--)        // 外层循环：控制毫秒数
        for(j = 120; j > 0; j--);  // 内层循环：约1ms
}

// ************************ 数码管显示函数 ************************
// 功能：根据传入的num值，控制两位数码管显示相应内容
// 参数：num=0 → 熄灭；num=17 → 显示"--"；num=1~16 → 显示对应选手编号
// 原理：动态扫描，每位点亮1ms，周期2ms（500Hz），利用视觉暂留稳定显示
// 注意：消隐操作必不可少，否则会产生鬼影（残影）
void display(uchar num)
{
    uchar ten, unit;
    
    // 根据num确定十位和个位应该显示的段码索引
    if(num == 17)          // 抢答允许状态：显示 "--"
    {
        ten = 11;          // 索引11对应横杠段码
        unit = 11;
    }
    else if(num == 0)      // 初始状态：熄灭
    {
        ten = 10;          // 索引10对应全灭段码
        unit = 10;
    }
    else                   // 显示选手编号（1~16）
    {
        ten = num / 10;    // 十位数字
        unit = num % 10;   // 个位数字
        if(ten == 0) ten = 10;   // 十位为0时不显示（熄灭前导零）
    }
    
    // ----- 动态扫描显示十位 -----
    P0 = 0x00;             // 清除段码（消隐）
    DIG_TEN = 1;           // 关闭十位位选
    DIG_UNIT = 1;          // 关闭个位位选（双重保险）
    // 以上三行是消隐操作，防止切换时残影
    
    P0 = seg_table[ten];   // 输出十位段码
    DIG_TEN = 0;           // 选通十位（低电平有效）
    delay_ms(1);           // 点亮1ms
    DIG_TEN = 1;           // 关闭十位
    
    // ----- 动态扫描显示个位 -----
    P0 = 0x00;             // 再次消隐
    DIG_TEN = 1;
    DIG_UNIT = 1;
    P0 = seg_table[unit];  // 输出个位段码
    DIG_UNIT = 0;          // 选通个位
    delay_ms(1);           // 点亮1ms
    DIG_UNIT = 1;          // 关闭个位
}

// ************************ 4×4矩阵键盘扫描函数（P1口）************************
// 行线：P1.0~P1.3（输出），列线：P1.4~P1.7（输入，带内部上拉）
// 返回值：1~16 对应16个按键，0表示无按键
// 原理：逐行扫描法（先检测有无按键，再逐行确定位置）
// 包含：消抖、等待释放，确保一次按下只返回一次有效值
uchar key_scan(void)
{
/*
 * row     : 行号（0~3），表示当前扫描的行，对应 P1.0~P1.3
 * col     : 列号（0~3），表示检测到的按键所在的列，对应 P1.4~P1.7
 * key_val : 按键编号（1~16），根据 row*4+col+1 计算得出的选手编号
 */
    uchar row, col, key_val;
    
    // 第一步：检测是否有按键按下（所有行输出0）
    P1 = 0x0F;   // 低四位输出0，高四位输入（写1使其成为输入，利用内部上拉）
    if((P1 & 0xF0) != 0xF0)   // 若高四位不全为1，说明有键按下
    {
        delay_ms(10);         // 延时消抖
        if((P1 & 0xF0) != 0xF0)   // 再次确认，消除抖动影响
        {
            // 第二步：逐行扫描，确定具体按键
            for(row = 0; row < 4; row++)
            {
                // 设置当前行输出0，其他行输出1；高四位保持输入（1）
                // ~(1 << row) 产生低四位屏蔽字：0xFE,0xFD,0xFB,0xF7
                P1 = 0xF0 | ~(1 << row);
                if((P1 & 0xF0) != 0xF0)   // 若某列变为0，表示该行有键按下
                {
                    // 读取列线状态（高四位）
                    col = (P1 & 0xF0) >> 4;
                    // 将列值映射为列号 0~3
                    switch(col)
                    {
                        case 0x0E: col = 0; break;  // 1110 → P1.4
                        case 0x0D: col = 1; break;  // 1101 → P1.5
                        case 0x0B: col = 2; break;  // 1011 → P1.6
                        case 0x07: col = 3; break;  // 0111 → P1.7
                        default: return 0;
                    }
                    // 计算按键编号：行号×4 + 列号 + 1（范围1~16）
                    key_val = row * 4 + col + 1;
                    // 等待按键释放（避免连按）
                    while((P1 & 0xF0) != 0xF0);  // 轮询直到所有列线恢复高电平
                    delay_ms(10);                // 释放后短暂延时，消除释放抖动
                    return key_val;
                }
            }
        }
    }
    return 0;   // 无按键按下
}

// ************************ 主函数 ************************
// 功能：初始化，状态机处理抢答流程
// 状态说明：
//   - allow_answer = 0：熄灭，禁止抢答（初始状态）
//   - allow_answer = 1 且 key_num = 0：显示"--"，允许抢答
//   - allow_answer = 1 且 key_num != 0：显示选手号，锁定
// 主持人按键按下（下降沿触发）：
//   - 无论当前状态，按下后都进入允许抢答状态（显示"--"，清空选手号）
void main(void)
{
    // 初始化IO口
    P0 = 0x00;   // 数码管段码初始为0（熄灭）
    P1 = 0xFF;   // P1口写1，准备输入（键盘列线）
    P2 = 0xFF;   // 位选关闭（高电平熄灭）
    P3 = 0xFF;   // P3口写1，主持人按键输入
    
    while(1)
    {
        // ----- 检测主持人按键（低电平有效，带消抖和等待释放）-----
        if(KEY_HOST == 0)                // 检测到按下
        {
            delay_ms(10);                // 消抖
            if(KEY_HOST == 0)            // 确认按下
            {
                
				allow_answer = 1;        // 允许抢答
				//allow_answer = ~allow_answer;  // 切换抢答状态
				// 如果想要切换的时候先熄屏，按下按钮再重新启动就使用上面这一句          

				key_num = 0;             // 清除上一轮选手编号
                while(KEY_HOST == 0);    // 等待按键释放（防止连按）
                // 注意：释放后状态已更新，显示"--"将在下面显示
            }
        }
        
        // ----- 状态机处理 -----
        if(allow_answer == 0)
        {
            // 状态1：初始状态（或主持人未按下），数码管熄灭
            display(0);
        }
        else
        {
            if(key_num == 0)
            {
                // 状态2：允许抢答状态，显示"--"，不断扫描键盘
                display(17);
                key_num = key_scan();    // 扫描选手按键，如有则记录编号
            }
            else
            {
                // 状态3：抢答锁定状态，显示选手编号，不再扫描（禁止其他选手）
                display(key_num);
                // 注意：这里没有再次调用key_scan，从而实现锁定
            }
        }
    }
}

/* ==================== 常见问题教学解释 ====================
 * Q1: 为什么P0口需要外接上拉电阻？
 * A1: 8051的P0口内部是开漏输出，高电平时呈高阻态，无法驱动数码管。
 *     外接4.7k~10k上拉电阻至VCC，才能输出有效高电平点亮段码。
 *
 * Q2: 为什么显示前要消隐（清段码+关位选）？
 * A2: 防止动态扫描切换时产生“鬼影”。如果不消隐，旧段码可能短暂出现在
 *     新选通的数码管上，造成残影。先消隐再送新段码可彻底避免。
 *
 * Q3: 延时1ms如何计算？能否精确？
 * A3: 12MHz晶振下机器周期=1μs。内层循环120次，每次DJNZ约2μs，加上循环
 *     控制开销，实测约1ms。不同优化等级会略有差异，可借助示波器校准。
 *
 * Q4: 为什么扫描键盘后要等待按键释放？
 * A4: 防止一次按下导致主循环多次检测，重复触发。等待释放能确保每次按键
 *     只产生一次抢答，避免同一选手按一次就重复记录（虽然锁定后无效，
 *     但等待释放是良好习惯）。
 *
 * Q5: 如何保证最先按下的选手有效？
 * A5: 在允许抢答状态（display(17)）中，不断调用key_scan()，一旦扫描到
 *     有效按键（非0），立即存入key_num并跳出该状态，此后不再扫描键盘，
 *     后续按键被忽略，从而实现锁定。
 *
 * Q6: 主持人按键为什么要等待释放？
 * A6: 如果没有等待释放，主持人按下瞬间会多次进入if(KEY_HOST==0)，
 *     虽然效果上allow_answer被多次置1不影响，但会导致key_num可能被
 *     反复清零，且浪费CPU时间。等待释放确保只响应一次。
 * ======================================================== */