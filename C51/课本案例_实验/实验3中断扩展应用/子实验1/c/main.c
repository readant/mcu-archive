/***************** 必要的变量定义 *****************/
#include<reg51.h>
#define uint unsigned int
#define uchar unsigned char  //宏定义

// 共阴数码管"0-9"编码表
uchar code table[] = {0x3F,0x06,0x5B,0x4F,0x66,0x6D,0x7D,0x07,0x7F,0x6F};
uchar m = 0;

/***************** 延时子程序 *****************/
// 延时 C 毫秒
void delay(uchar c)
{
    unsigned char a,b;
    for(;c>0;c--)
        for(b=142;b>0;b--)
            for(a=2;a>0;a--);
}

/***************** 外部中断0子程序 *****************/
void INT_0() interrupt 0
{
    EX0 = 0;                  //关闭外部中断0，防止在执行过程中再次发生中断
    delay(20);                //延时20ms，去抖动
    EX0 = 1;                  //开外部中断0
    m++;
    if(m == 10) m = 0;        //当m=10时返回到0
    else P1 = table[m];       //循环输出"0~9"
}

/***************** 外部中断1子程序 *****************/
void INT_1() interrupt 2
{
    EX1 = 0;                  //关闭外部中断1，防止在执行过程中再次发生中断
    delay(20);                //延时20ms，去抖动
    EX1 = 1;                  //开外部中断1
    m--;
    P1 = table[m];            //循环输出"9~0"
    if(m == 0) m = 10;        //当m=0时返回到10
}

/***************** 主程序 *****************/
void main()
{
    P1 = 0x00;
    EA = 1;                   //打开总中断
    EX0 = 1;                  //打开外部中断0
    IT0 = 1;                  //设置中断触发方式为下降沿触发方式
    EX1 = 1;                  //打开外部中断1
    IT1 = 1;                  //设置中断触发方式为下降沿触发方式
    while(1);                 //死循环
}