/***************** 必要的变量定义 *****************/
#include<reg51.h>
#define uchar unsigned char  //宏定义

/***************** 延时子程序 *****************/
// 延时 C 毫秒
void delay(uchar c)
{
    unsigned char a,b;
    for(;c>0;c--)
        for(b=142;b>0;b--)
            for(a=2;a>0;a--);
}

/***************** 外部中断0子程序 *****************/
void INT_0() interrupt 0
{
    EX0 = 0;                  //关闭外部中断0，防止在执行过程中再次发生中断
    delay(20);                //延时20ms，去抖动
    EX0 = 1;                  //开外部中断0
    while(1)                  //LED向下循环点亮，表示在执行外部中断0服务程序
    {
        P1 = 0xfe; delay(200);
        P1 = 0xfd; delay(200);
        P1 = 0xfb; delay(200);
        P1 = 0xf7; delay(200);
        P1 = 0xef; delay(200);
        P1 = 0xdf; delay(200);
        P1 = 0xbf; delay(200);
        P1 = 0x7f; delay(200);
    }
}

/***************** 外部中断1子程序 *****************/
void INT_1() interrupt 2
{
    EX1 = 0;                  //关闭外部中断1，防止在执行过程中再次发生中断
    delay(20);                //延时20ms，去抖动
    EX1 = 1;                  //开外部中断1
    // LED全部点亮，闪烁3次，表示在执行外部中断1服务程序
    P1 = 0x00; delay(200);
    P1 = 0xFF; delay(200);
    P1 = 0x00; delay(200);
    P1 = 0xFF; delay(200);
    P1 = 0x00; delay(200);
    P1 = 0xFF; delay(200);
}

/***************** 主程序 *****************/
void main()
{
    P1 = 0xFF;                // P1口初始为高电平，LED全灭
    EA = 1;                   // 打开总中断
    EX0 = 1;                  // 打开外部中断0
    IP = 0x04;                // 外部中断1为高优先级
    IT0 = 1;                  // 设置外部中断0触发方式为下降沿触发
    EX1 = 1;                  // 打开外部中断1
    IT1 = 1;                  // 设置外部中断1触发方式为下降沿触发
    while(1);                 // 死循环，等待中断
}